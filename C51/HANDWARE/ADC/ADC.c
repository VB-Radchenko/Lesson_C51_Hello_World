//==============================================================================
//---------------------------------Includes-------------------------------------
//==============================================================================
#include "ADC.h"

//==============================================================================
//---------------------------------Defines--------------------------------------
//==============================================================================
#define ADC_START_ADDR		0x32

//==============================================================================
//---------------------------------ADC READ-------------------------------------
//==============================================================================
//channel:0-7
u16 AdcRead(u16 channel)
{
	ReadDgusVp(ADC_START_ADDR+channel,(u8*)&channel,1);
	
	return channel;
}

//==============================================================================
//-----------------------------ADC READ AVERAGE---------------------------------
//==============================================================================
u16 AdcReadAvg(u16 channel,u16 avg_cnt)
{
	u16 cnt;
	u16 ad;
	u16 max_ad = 0;
	u16 min_ad = 0xFFFF;
	float ad_sum = 0;
	
	for(cnt=0;cnt<avg_cnt;cnt++)
	{
	//	sys_delay_ms(100);

		ad = AdcRead(channel);
		ad_sum += ad;
		if(ad>max_ad)
			max_ad = ad;
		if(ad<min_ad)
			min_ad = ad;
	}
	if(avg_cnt>2)
	{
		ad_sum = ad_sum-max_ad-min_ad;
		avg_cnt -= 2;
	}
	ad = (u16)(ad_sum/avg_cnt+0.5f);
	
	return ad;
}

//==============================================================================
//---------------------------------END FILE-------------------------------------
//==============================================================================
